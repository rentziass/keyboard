// ==== MOUSE-KEY <section begins> ====
#define ZMK_MOUSE_DEFAULT_MOVE_VAL 600
#define ZMK_MOUSE_DEFAULT_SCRL_VAL 10

#include <dt-bindings/zmk/mouse.h>

&mmv {
  acceleration-exponent = <1>;
  time-to-max-speed-ms = <300>;
  delay-ms = <0>;
};

&msc {
  acceleration-exponent = <0>;
  time-to-max-speed-ms = <300>;
  delay-ms = <0>;
};
// ==== MOUSE-KEY <section ends> =====
